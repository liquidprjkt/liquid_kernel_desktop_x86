## kernel/Kconfig.hz
```kconfig
# SPDX-License-Identifier: GPL-2.0-only
#
# Timer Interrupt Frequency Configuration
#

config HZ
	int "Timer frequency"
	range 100 1000
	default 500
	help
	 Allows the configuration of the timer frequency. It is customary
	 to have the timer interrupt run at 1000 Hz but 100 Hz may be more
	 beneficial for servers and NUMA systems that do not need to have
	 a fast response for user interaction and that may experience bus
	 contention and cacheline bounces as a result of timer interrupts.
	 Note that the timer interrupt occurs on each processor in an SMP
	 environment leading to NR_CPUS * HZ number of timer interrupts
	 per second.

config SCHED_HRTICK
	def_bool HIGH_RES_TIMERS

config MIN_BASE_SLICE_NS
	int "Default value for min_base_slice_ns"
	default 2000000
	help
	 The BORE Scheduler automatically calculates the optimal base
	 slice for the configured HZ using the following equation:
	 
	 base_slice_ns =
	 	1000000000/HZ * DIV_ROUNDUP(min_base_slice_ns, 1000000000/HZ)
	 
	 This option sets the default lower bound limit of the base slice
	 to prevent the loss of task throughput due to overscheduling.
	 
	 Setting this value too high can cause the system to boot with
	 an unnecessarily large base slice, resulting in high scheduling
	 latency and poor system responsiveness.
```
